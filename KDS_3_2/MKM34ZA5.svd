# MKM34ZA5 register map
Vendor: Freescale Semiconductor, Inc.; Series: Kinetis_M; File version: 1.6
MKM34ZA5 Freescale Microcontroller
CPU: CM0PLUS r0p0, little endian, no MPU, no FPU, VTOR, 2 interrupt priority bits
Registers are 8-bit, read-write, reset 0x0 unless marked. A register's access mark holds for its fields unless they carry their own. Offsets are from the block's base; lines under a group give offsets from that group; [hi:lo] are bit positions; {n}, {i} and the like mark numbered series; 'fields as' and 'values as' point back to an identical list; <NAME> marks a mode.

## Memory map
0x00000400 FTFA_FlashConfig size 0xE — Flash configuration field
0x40000000 AIPS blocks up to offset 0x70 — AIPS-Lite Bridge
0x40008000 DMA blocks up to offset 0x140 — DMA Controller
0x4000A000 MPU size 0x820 — Memory protection unit
0x40020000 FTFA size 0x14 — Flash Memory Interface
0x40021000 DMAMUX0 size 0x1 — DMA channel multiplexor
0x40022000 DMAMUX1 size 0x1 — DMA channel multiplexor
0x40023000 DMAMUX2 size 0x1 — DMA channel multiplexor
0x40024000 DMAMUX3 size 0x1 — DMA channel multiplexor
0x40029000 RNG size 0x10 — Random Number Generator Accelerator
0x4002B000 ADC size 0x60 — Analog-to-Digital Converter
0x4002D000 PIT0 size 0x120 — Periodic Interrupt Timer
0x4002E000 PIT1 size 0x120 — Periodic Interrupt Timer
0x40030000 AFE size 0x60 — Analog Front End
0x40034000 CRC size 0xC — Cyclic Redundancy Check
0x4003C000 LPTMR size 0x10 — Low Power Timer
0x4003E000 SIM size 0x1070 — System Integration Module
0x40043000 LCD size 0x60 — Segment Liquid Crystal Display
0x40046000 PORTA size 0xA4 — Pin Control and Interrupts
0x40047000 PORTB size 0xA4 — Pin Control and Interrupts
0x40048000 PORTC size 0xA4 — Pin Control and Interrupts
0x40049000 PORTD size 0xA4 — Pin Control and Interrupts
0x4004A000 PORTE size 0xCC — Pin Control and Interrupts
0x4004B000 PORTF size 0xA4 — Pin Control and Interrupts
0x4004C000 PORTG size 0xA4 — Pin Control and Interrupts
0x4004D000 PORTH size 0xA4 — Pin Control and Interrupts
0x4004E000 PORTI size 0xA4 — Pin Control and Interrupts
0x40050000 RTC size 0x44 — Real Time Clock
0x40053000 WDOG size 0x18 — Generation 2008 Watchdog Timer
0x40055000 XBAR size 0x24 — Crossbar Switch
0x40057000 TMR0 size 0x20 — Quad Timer
0x40058000 TMR1 size 0x20 — Quad Timer
0x40059000 TMR2 size 0x20 — Quad Timer
0x4005A000 TMR3 size 0x20 — Quad Timer
0x40061000 EWM size 0x4 — External Watchdog Monitor
0x40064000 MCG size 0xF — Multipurpose Clock Generator module
0x40066000 OSC size 0x1 — Oscillator
0x40067000 I2C0 size 0xC — Inter-Integrated Circuit
0x40068000 I2C1 size 0xC — Inter-Integrated Circuit
0x4006A000 UART0 size 0x17 — Serial Communication Interface
0x4006B000 UART1 size 0x20 — Serial Communication Interface
0x4006C000 UART2 size 0x17 — Serial Communication Interface
0x4006D000 UART3 size 0x20 — Serial Communication Interface
0x4006F000 VREF size 0x6 — Voltage Reference
0x40072000 CMP0 size 0x6 — High-Speed Comparator (CMP), Voltage Reference (VREF) Digital-to-Analog Converter (DAC), and Analog Mux (ANMUX)
0x40072008 CMP1 size 0x6 — High-Speed Comparator (CMP), Voltage Reference (VREF) Digital-to-Analog Converter (DAC), and Analog Mux (ANMUX)
0x40075000 SPI0 size 0xC — Serial Peripheral Interface
0x40076000 SPI1 size 0xC — Serial Peripheral Interface
0x4007B000 RCM size 0x6 — Reset Control Module
0x4007C000 LLWU size 0xA — Low leakage wakeup unit
0x4007D000 PMC size 0x3 — Power Management Controller
0x4007E000 SMC size 0x4 — System Mode Controller
0x400FF000 GPIOA size 0x1D — General Purpose Input/Output
0x400FF001 GPIOB size 0x1D — General Purpose Input/Output
0x400FF002 GPIOC size 0x1D — General Purpose Input/Output
0x400FF003 GPIOD size 0x1D — General Purpose Input/Output
0x400FF040 GPIOE size 0x1D — General Purpose Input/Output
0x400FF041 GPIOF size 0x1D — General Purpose Input/Output
0x400FF042 GPIOG size 0x1D — General Purpose Input/Output
0x400FF043 GPIOH size 0x1D — General Purpose Input/Output
0x400FF080 GPIOI size 0x1D — General Purpose Input/Output
0xE000E000 SystemControl blocks up to offset 0xD34 — System Control Registers
0xE000E010 SysTick size 0x10 — System timer
0xE000E100 NVIC size 0x320 — Nested Vectored Interrupt Controller
0xF0000000 MTB size 0x1000 — Micro Trace Buffer
0xF0001000 MTBDWT size 0x1000 — MTB data watchpoint and trace
0xF0002000 ROM size 0x1000 — System ROM
0xF0003000 MCM blocks up to offset 0x84 — Core Platform Miscellaneous Control Module

## Interrupts
0 DMA0 (DMA)
1 DMA1 (DMA)
2 DMA2 (DMA)
3 DMA3 (DMA)
4 SPI0
5 SPI1
6 PMC
7 TMR0
8 TMR1
9 TMR2
10 TMR3
11 PIT0_PIT1 (PIT0, PIT1)
12 LLWU
13 FTFA
14 CMP0_CMP1 (CMP0, CMP1)
15 LCD
16 ADC
17 PTx (PORTA, PORTB, PORTC, PORTD, PORTE, PORTF, PORTG, PORTH, PORTI, GPIOA, GPIOB, GPIOC, GPIOD, GPIOE, GPIOF, GPIOG, GPIOH, GPIOI)
18 RNGA (RNG)
19 UART0_UART1 (UART0, UART1)
20 UART2_UART3 (UART2, UART3)
21 AFE_CH0 (AFE)
22 AFE_CH1 (AFE)
23 AFE_CH2 (AFE)
24 AFE_CH3 (AFE)
25 RTC
26 I2C0_I2C1 (I2C0, I2C1)
27 EWM
28 MCG
29 Watchdog (WDOG)
30 LPTMR
31 XBAR

## Licence text in the file
Redistribution and use in source and binary forms, with or without modification, are permitted provided that the following conditions are met: o Redistributions of source code must retain the above copyright notice, this list of conditions and the following disclaimer. o Redistributions in binary form must reproduce the above copyright notice, this list of conditions and the following disclaimer in the documentation and/or other materials provided with the distribution. o Neither the name of Freescale Semiconductor, Inc. nor the names of its contributors may be used to endorse or promote products derived from this software without specific prior written permission. THIS SOFTWARE IS PROVIDED BY THE COPYRIGHT HOLDERS AND CONTRIBUTORS "AS IS" AND. ANY EXPRESS OR IMPLIED WARRANTIES, INCLUDING, BUT NOT LIMITED TO, THE IMPLIED. WARRANTIES OF MERCHANTABILITY AND FITNESS FOR A PARTICULAR PURPOSE ARE. DISCLAIMED. IN NO EVENT SHALL THE COPYRIGHT HOLDER OR CONTRIBUTORS BE LIABLE FOR. ANY DIRECT, INDIRECT, INCIDENTAL, SPECIAL, EXEMPLARY, OR CONSEQUENTIAL DAMAGES (INCLUDING, BUT NOT LIMITED TO, PROCUREMENT OF SUBSTITUTE GOODS OR SERVICES; LOSS OF USE, DATA, OR PROFITS; OR BUSINESS INTERRUPTION) HOWEVER CAUSED AND ON. ANY THEORY OF LIABILITY, WHETHER IN CONTRACT, STRICT LIABILITY, OR TORT (INCLUDING NEGLIGENCE OR OTHERWISE) ARISING IN ANY WAY OUT OF THE USE OF THIS. SOFTWARE, EVEN IF ADVISED OF THE POSSIBILITY OF SUCH DAMAGE.
