# MKV10Z1287 register map
Vendor: Freescale Semiconductor, Inc.; Series: Kinetis_V; File version: 1.6
MKV10Z1287 Freescale Microcontroller
CPU: CM0PLUS r0p0, little endian, no MPU, no FPU, VTOR, 2 interrupt priority bits
Registers are 32-bit, read-write, reset 0x0 unless marked. A register's access mark holds for its fields unless they carry their own. Offsets are from the block's base; lines under a group give offsets from that group; [hi:lo] are bit positions; {n}, {i} and the like mark numbered series; 'fields as' and 'values as' point back to an identical list; <NAME> marks a mode.

## Memory map
0x00000400 FTFA_FlashConfig size 0xE — Flash configuration field
0x40008000 DMA size 0x1100 — Enhanced direct memory access controller
0x40020000 FTFA size 0x2C — Flash Memory Interface
0x40021000 DMAMUX size 0x8 — DMA channel multiplexor
0x40026000 FTM3 size 0x9C — FlexTimer Module
0x40027000 FTM4 size 0x9C — FlexTimer Module
0x40028000 FTM5 size 0x9C — FlexTimer Module
0x4002C000 SPI0 size 0x140 — Serial Peripheral Interface
0x40031000 PDB1 size 0x19C — Programmable Delay Block
0x40032000 CRC size 0xC — Cyclic Redundancy Check
0x40036000 PDB0 size 0x19C — Programmable Delay Block
0x40038000 FTM0 size 0x9C — FlexTimer Module
0x40039000 FTM1 size 0x9C — FlexTimer Module
0x4003A000 FTM2 size 0x9C — FlexTimer Module
0x4003B000 ADC0 size 0x70 — Analog-to-Digital Converter
0x4003C000 ADC1 size 0x70 — Analog-to-Digital Converter
0x4003F000 DAC0 size 0x24 — 12-Bit Digital-to-Analog Converter
0x40040000 LPTMR0 size 0x10 — Low Power Timer
0x40047000 SIM size 0x1104 — System Integration Module
0x40049000 PORTA size 0xA4 — Pin Control and Interrupts
0x4004A000 PORTB size 0xA4 — Pin Control and Interrupts
0x4004B000 PORTC size 0xA4 — Pin Control and Interrupts
0x4004C000 PORTD size 0xA4 — Pin Control and Interrupts
0x4004D000 PORTE size 0xA4 — Pin Control and Interrupts
0x40052000 WDOG size 0x18 — Generation 2008 Watchdog Timer
0x40061000 EWM size 0x6 — External Watchdog Monitor
0x40064000 MCG size 0xC — Multipurpose Clock Generator module
0x40065000 OSC0 size 0x1 — Oscillator
0x40066000 I2C0 size 0xC — Inter-Integrated Circuit
0x4006A000 UART0 size 0x17 — Serial Communication Interface
0x4006B000 UART1 size 0x17 — Serial Communication Interface
0x40073000 CMP0 size 0x6 — High-Speed Comparator (CMP), Voltage Reference (VREF) Digital-to-Analog Converter (DAC), and Analog Mux (ANMUX)
0x40073008 CMP1 size 0x6 — High-Speed Comparator (CMP), Voltage Reference (VREF) Digital-to-Analog Converter (DAC), and Analog Mux (ANMUX)
0x4007C000 LLWU size 0x10 — Low leakage wakeup unit
0x4007D000 PMC size 0x3 — Power Management Controller
0x4007E000 SMC size 0x4 — System Mode Controller
0x4007F000 RCM size 0x6 — Reset Control Module
0x400FF000 GPIOA size 0x18 — General Purpose Input/Output
0x400FF040 GPIOB size 0x18 — General Purpose Input/Output
0x400FF080 GPIOC size 0x18 — General Purpose Input/Output
0x400FF0C0 GPIOD size 0x18 — General Purpose Input/Output
0x400FF100 GPIOE size 0x18 — General Purpose Input/Output
0xE000E000 SystemControl blocks up to offset 0xD34 — System Control Registers
0xE000E010 SysTick size 0x10 — System timer
0xE000E100 NVIC size 0x320 — Nested Vectored Interrupt Controller
0xF0000000 MTB size 0x1000 — Micro Trace Buffer
0xF0001000 MTBDWT size 0x1000 — MTB data watchpoint and trace
0xF0002000 ROM size 0x1000 — System ROM
0xF0003000 MCM blocks up to offset 0x44 — Core Platform Miscellaneous Control Module
0xF0004000 MMDVSQ size 0x14 — Divide and Square Root
0xF8000000 FGPIOA size 0x18 — General Purpose Input/Output
0xF8000040 FGPIOB size 0x18 — General Purpose Input/Output
0xF8000080 FGPIOC size 0x18 — General Purpose Input/Output
0xF80000C0 FGPIOD size 0x18 — General Purpose Input/Output
0xF8000100 FGPIOE size 0x18 — General Purpose Input/Output

## Interrupts
0 DMA0_DMA4 (DMA)
1 DMA1_DMA5 (DMA)
2 DMA2_DMA6 (DMA)
3 DMA3_DMA7 (DMA)
4 DMA_Error (DMA)
5 FTFA
6 LVD_LVW (PMC)
7 LLWU
8 I2C0
10 SPI0
12 UART0
13 UART1
15 ADC0
16 ADC1
17 FTM0
18 FTM1
19 FTM2
20 CMP0
21 CMP1
22 FTM3
23 WDOG_EWM (WDOG, EWM)
24 FTM4
25 DAC0
26 FTM5
27 MCG
28 LPTMR0
29 PDB0_PDB1 (PDB0, PDB1)
30 PORTA (PORTA, GPIOA)
31 PORTB_PORTC_PORTD_PORTE (PORTB, PORTC, PORTD, PORTE, GPIOB, GPIOC, GPIOD, GPIOE)

## Licence text in the file
Redistribution and use in source and binary forms, with or without modification, are permitted provided that the following conditions are met: o Redistributions of source code must retain the above copyright notice, this list of conditions and the following disclaimer. o Redistributions in binary form must reproduce the above copyright notice, this list of conditions and the following disclaimer in the documentation and/or other materials provided with the distribution. o Neither the name of Freescale Semiconductor, Inc. nor the names of its contributors may be used to endorse or promote products derived from this software without specific prior written permission. THIS SOFTWARE IS PROVIDED BY THE COPYRIGHT HOLDERS AND CONTRIBUTORS "AS IS" AND. ANY EXPRESS OR IMPLIED WARRANTIES, INCLUDING, BUT NOT LIMITED TO, THE IMPLIED. WARRANTIES OF MERCHANTABILITY AND FITNESS FOR A PARTICULAR PURPOSE ARE. DISCLAIMED. IN NO EVENT SHALL THE COPYRIGHT HOLDER OR CONTRIBUTORS BE LIABLE FOR. ANY DIRECT, INDIRECT, INCIDENTAL, SPECIAL, EXEMPLARY, OR CONSEQUENTIAL DAMAGES (INCLUDING, BUT NOT LIMITED TO, PROCUREMENT OF SUBSTITUTE GOODS OR SERVICES; LOSS OF USE, DATA, OR PROFITS; OR BUSINESS INTERRUPTION) HOWEVER CAUSED AND ON. ANY THEORY OF LIABILITY, WHETHER IN CONTRACT, STRICT LIABILITY, OR TORT (INCLUDING NEGLIGENCE OR OTHERWISE) ARISING IN ANY WAY OUT OF THE USE OF THIS. SOFTWARE, EVEN IF ADVISED OF THE POSSIBILITY OF SUCH DAMAGE.
