# MK21DA5 register map
Vendor: Freescale Semiconductor, Inc.; Series: Kinetis_K; File version: 1.6
CPU: CM4 r0p1, little endian, no MPU, no FPU, VTOR, 4 interrupt priority bits
Registers are 8-bit, read-write, reset 0x0 unless marked. A register's access mark holds for its fields unless they carry their own. Offsets are from the block's base; [hi:lo] are bit positions; {n}, {i} and the like mark numbered series.

## NVIC — Nested Vectored Interrupt Controller
Base 0xE000E100
{0x0+4i} NVICISER{i} 32-bit (i=0..3) — Interrupt Set Enable Register n
  [31:0] SETENA — Interrupt set enable bits
{0x80+4i} NVICICER{i} 32-bit (i=0..3) — Interrupt Clear Enable Register n
  [31:0] CLRENA — Interrupt clear-enable bits
{0x100+4i} NVICISPR{i} 32-bit (i=0..3) — Interrupt Set Pending Register n
  [31:0] SETPEND — Interrupt set-pending bits
{0x180+4i} NVICICPR{i} 32-bit (i=0..3) — Interrupt Clear Pending Register n
  [31:0] CLRPEND — Interrupt clear-pending bits
{0x200+4i} NVICIABR{i} 32-bit (i=0..3) — Interrupt Active bit Register n
  [31:0] ACTIVE — Interrupt active flags
{0x300+i} NVICIP{i} (i=0..15) — Interrupt Priority Register {i}
  [7:0] PRI{i} — Priority of the INT_DMA{i} interrupt {i}
0x310 NVICIP16 — Interrupt Priority Register 16
  [7:0] PRI16 — Priority of the INT_DMA_Error interrupt 16
0x311 NVICIP17 — Interrupt Priority Register 17
  [7:0] PRI17 — Priority of the INT_MCM interrupt 17
0x312 NVICIP18 — Interrupt Priority Register 18
  [7:0] PRI18 — Priority of the INT_FTFL interrupt 18
0x313 NVICIP19 — Interrupt Priority Register 19
  [7:0] PRI19 — Priority of the INT_Read_Collision interrupt 19
0x314 NVICIP20 — Interrupt Priority Register 20
  [7:0] PRI20 — Priority of the INT_LVD_LVW interrupt 20
0x315 NVICIP21 — Interrupt Priority Register 21
  [7:0] PRI21 — Priority of the INT_LLWU interrupt 21
0x316 NVICIP22 — Interrupt Priority Register 22
  [7:0] PRI22 — Priority of the INT_WDOG_EWM interrupt 22
0x317 NVICIP23 — Interrupt Priority Register 23
  [7:0] PRI23 — Priority of the INT_RNG interrupt 23
0x318 NVICIP24 — Interrupt Priority Register 24
  [7:0] PRI24 — Priority of the INT_I2C0 interrupt 24
0x319 NVICIP25 — Interrupt Priority Register 25
  [7:0] PRI25 — Priority of the INT_I2C1 interrupt 25
0x31A NVICIP26 — Interrupt Priority Register 26
  [7:0] PRI26 — Priority of the INT_SPI0 interrupt 26
0x31B NVICIP27 — Interrupt Priority Register 27
  [7:0] PRI27 — Priority of the INT_SPI1 interrupt 27
0x31C NVICIP28 — Interrupt Priority Register 28
  [7:0] PRI28 — Priority of the INT_I2S0_Tx interrupt 28
0x31D NVICIP29 — Interrupt Priority Register 29
  [7:0] PRI29 — Priority of the INT_I2S0_Rx interrupt 29
0x31E NVICIP30 — Interrupt Priority Register 30
  [7:0] PRI30 — Priority of interrupt 30
0x31F NVICIP31 — Interrupt Priority Register 31
  [7:0] PRI31 — Priority of the INT_UART0_RX_TX interrupt 31
0x320 NVICIP32 — Interrupt Priority Register 32
  [7:0] PRI32 — Priority of the INT_UART0_ERR interrupt 32
0x321 NVICIP33 — Interrupt Priority Register 33
  [7:0] PRI33 — Priority of the INT_UART1_RX_TX interrupt 33
0x322 NVICIP34 — Interrupt Priority Register 34
  [7:0] PRI34 — Priority of the INT_UART1_ERR interrupt 34
0x323 NVICIP35 — Interrupt Priority Register 35
  [7:0] PRI35 — Priority of the INT_UART2_RX_TX interrupt 35
0x324 NVICIP36 — Interrupt Priority Register 36
  [7:0] PRI36 — Priority of the INT_UART2_ERR interrupt 36
0x325 NVICIP37 — Interrupt Priority Register 37
  [7:0] PRI37 — Priority of the INT_UART3_RX_TX interrupt 37
0x326 NVICIP38 — Interrupt Priority Register 38
  [7:0] PRI38 — Priority of the INT_UART3_ERR interrupt 38
0x327 NVICIP39 — Interrupt Priority Register 39
  [7:0] PRI39 — Priority of the INT_ADC0 interrupt 39
0x328 NVICIP40 — Interrupt Priority Register 40
  [7:0] PRI40 — Priority of the INT_CMP0 interrupt 40
0x329 NVICIP41 — Interrupt Priority Register 41
  [7:0] PRI41 — Priority of the INT_CMP1 interrupt 41
{0x300+i} NVICIP{i} (i=42..44) — Interrupt Priority Register {i}
  [7:0] PRI{i} — Priority of the INT_FTM{i-42} interrupt {i}
0x32D NVICIP45 — Interrupt Priority Register 45
  [7:0] PRI45 — Priority of the INT_CMT interrupt 45
0x32E NVICIP46 — Interrupt Priority Register 46
  [7:0] PRI46 — Priority of the INT_RTC interrupt 46
0x32F NVICIP47 — Interrupt Priority Register 47
  [7:0] PRI47 — Priority of the INT_RTC_Seconds interrupt 47
{0x300+i} NVICIP{i} (i=48..51) — Interrupt Priority Register {i}
  [7:0] PRI{i} — Priority of the INT_PIT{i-48} interrupt {i}
0x334 NVICIP52 — Interrupt Priority Register 52
  [7:0] PRI52 — Priority of the INT_PDB0 interrupt 52
0x335 NVICIP53 — Interrupt Priority Register 53
  [7:0] PRI53 — Priority of the INT_USB0 interrupt 53
0x336 NVICIP54 — Interrupt Priority Register 54
  [7:0] PRI54 — Priority of the INT_USBDCD interrupt 54
0x337 NVICIP55 — Interrupt Priority Register 55
  [7:0] PRI55 — Priority of interrupt 55
0x338 NVICIP56 — Interrupt Priority Register 56
  [7:0] PRI56 — Priority of the INT_DAC0 interrupt 56
0x339 NVICIP57 — Interrupt Priority Register 57
  [7:0] PRI57 — Priority of the INT_MCG interrupt 57
0x33A NVICIP58 — Interrupt Priority Register 58
  [7:0] PRI58 — Priority of the INT_LPTMR0 interrupt 58
0x33B NVICIP59 — Interrupt Priority Register 59
  [7:0] PRI59 — Priority of the INT_PORTA interrupt 59
0x33C NVICIP60 — Interrupt Priority Register 60
  [7:0] PRI60 — Priority of the INT_PORTB interrupt 60
0x33D NVICIP61 — Interrupt Priority Register 61
  [7:0] PRI61 — Priority of the INT_PORTC interrupt 61
0x33E NVICIP62 — Interrupt Priority Register 62
  [7:0] PRI62 — Priority of the INT_PORTD interrupt 62
0x33F NVICIP63 — Interrupt Priority Register 63
  [7:0] PRI63 — Priority of the INT_PORTE interrupt 63
0x340 NVICIP64 — Interrupt Priority Register 64
  [7:0] PRI64 — Priority of the INT_SWI interrupt 64
{0x300+i} NVICIP{i} (i=65..239) — Interrupt Priority Register {i}
  [7:0] PRI{i} — Priority of interrupt {i}
0xE00 NVICSTIR 32-bit — Software Trigger Interrupt Register
  [8:0] INTID — Interrupt ID of the interrupt to trigger, in the range 0-239. For example, a value of 0x03 specifies interrupt IRQ3.
