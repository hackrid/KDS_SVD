# MKV45F15 register map
Vendor: Freescale Semiconductor, Inc.; Series: Kinetis_V; File version: 1.6
MKV45F15 Freescale Microcontroller
CPU: CM4 r0p1, little endian, no MPU, FPU, VTOR, 4 interrupt priority bits
Registers are 32-bit, read-write, reset 0x0 unless marked. A register's access mark holds for its fields unless they carry their own. Offsets are from the block's base; lines under a group give offsets from that group; [hi:lo] are bit positions; {n}, {i} and the like mark numbered series; 'fields as' and 'values as' point back to an identical list; <NAME> marks a mode.

## Memory map
0x00000400 FTFL_FlashConfig size 0x10 — Flash configuration field
0x40000000 AIPS size 0x70 — AIPS-Lite Bridge
0x40008000 DMA size 0x1200 — Enhanced direct memory access controller
0x4001F000 FMC size 0x2E0 — Flash Memory Controller
0x40020000 FTFA size 0x2C — Flash Memory Interface
0x40021000 DMAMUX size 0x10 — Direct memory access multiplexer
0x40024000 CAN0 size 0x8C0 — Flex Controller Area Network module
0x40025000 CAN1 size 0x8C0 — Flex Controller Area Network module
0x40026000 FTM3 size 0x9C — FlexTimer Module
0x4002C000 SPI size 0x140 — Serial Peripheral Interface
0x40031000 PDB1 size 0x1A4 — Programmable Delay Block
0x40032000 CRC size 0xC — Cyclic Redundancy Check
0x40033000 PWMA size 0x196 — Pulse Width Modulator with nano edge placement
0x40036000 PDB0 size 0x1A4 — Programmable Delay Block
0x40037000 PIT size 0x140 — Periodic Interrupt Timer
0x40038000 FTM0 size 0x9C — FlexTimer Module
0x40039000 FTM1 size 0x9C — FlexTimer Module
0x40040000 LPTMR size 0x10 — Low Power Timer
0x40047000 SIM size 0x110C — System Integration Module
0x40049000 PORTA size 0xA4 — Pin Control and Interrupts
0x4004A000 PORTB size 0xA4 — Pin Control and Interrupts
0x4004B000 PORTC size 0xA4 — Pin Control and Interrupts
0x4004C000 PORTD size 0xCC — Pin Control and Interrupts
0x4004D000 PORTE size 0xA4 — Pin Control and Interrupts
0x40052000 WDOG size 0x18 — Generation 2008 Watchdog Timer
0x40055000 ENC size 0x28 — Quadrature Decoder
0x40059000 XBARA size 0x40 — Crossbar Switch
0x4005A000 XBARB size 0x10 — Crossbar Switch
0x4005B000 AOI size 0x10 — AND/OR/INVERT module
0x4005C000 ADC size 0xAC — Analog to digital converter
0x40061000 EWM size 0x4 — External Watchdog Monitor
0x40064000 MCG size 0xE — Multipurpose Clock Generator module
0x40065000 OSC size 0x3 — Oscillator
0x40066000 I2C size 0xC — Inter-Integrated Circuit
0x4006A000 UART0 size 0x17 — Serial Communication Interface
0x4006B000 UART1 size 0x17 — Serial Communication Interface
0x40073000 CMP0 size 0x6 — High-Speed Comparator (CMP), Voltage Reference (VREF) Digital-to-Analog Converter (DAC), and Analog Mux (ANMUX)
0x40073008 CMP1 size 0x6 — High-Speed Comparator (CMP), Voltage Reference (VREF) Digital-to-Analog Converter (DAC), and Analog Mux (ANMUX)
0x40073010 CMP2 size 0x6 — High-Speed Comparator (CMP), Voltage Reference (VREF) Digital-to-Analog Converter (DAC), and Analog Mux (ANMUX)
0x40073018 CMP3 size 0x6 — High-Speed Comparator (CMP), Voltage Reference (VREF) Digital-to-Analog Converter (DAC), and Analog Mux (ANMUX)
0x4007C000 LLWU size 0x10 — Low leakage wakeup unit
0x4007D000 PMC size 0x3 — Power Management Controller
0x4007E000 SMC size 0x4 — System Mode Controller
0x4007F000 RCM size 0xA — Reset Control Module
0x400FF000 GPIOA size 0x18 — General Purpose Input/Output
0x400FF040 GPIOB size 0x18 — General Purpose Input/Output
0x400FF080 GPIOC size 0x18 — General Purpose Input/Output
0x400FF0C0 GPIOD size 0x18 — General Purpose Input/Output
0x400FF100 GPIOE size 0x18 — General Purpose Input/Output
0xE000E000 SystemControl blocks up to offset 0xF40 — System Control Registers
0xE000E010 SysTick size 0x10 — System timer
0xE000E100 NVIC size 0xE04 — Nested Vectored Interrupt Controller
0xE0080000 MCM blocks up to offset 0x44 — Core Platform Miscellaneous Control Module

## Interrupts
{n} DMA{n} (DMA) (n=0..15)
16 DMA_Error (DMA)
17 MCM
18 FTFA
19 FTFA_Collision (FTFA)
20 PMC
21 LLWU
22 WDOG_EWM (WDOG, EWM)
24 I2C0 (I2C)
26 SPI
31 UART0_RX_TX (UART0)
32 UART0_ERR (UART0)
33 UART1_RX_TX (UART1)
34 UART1_ERR (UART1)
38 ADC_ERR (ADC)
39 ADCA (ADC)
40 CMP0
41 CMP1
42 FTM0
43 FTM1
48 PIT0 (PIT)
49 PIT1 (PIT)
50 PIT2 (PIT)
51 PIT3 (PIT)
52 PDB0
54 XBARA
55 PDB1
57 MCG
58 LPTMR0 (LPTMR)
59 PORTA (PORTA, GPIOA)
60 PORTB (PORTB, GPIOB)
61 PORTC (PORTC, GPIOC)
62 PORTD (PORTD, GPIOD)
63 PORTE (PORTE, GPIOE)
66 ENC_COMPARE (ENC)
67 ENC_HOME (ENC)
68 ENC_WDOG_SAB (ENC)
69 ENC_INDEX (ENC)
70 CMP2
71 FTM3
73 ADCB (ADC)
75 CAN0_ORed_Message_buffer (CAN0)
76 CAN0_Bus_Off (CAN0)
77 CAN0_Error (CAN0)
78 CAN0_Tx_Warning (CAN0)
79 CAN0_Rx_Warning (CAN0)
80 CAN0_Wake_Up (CAN0)
81 PWMA_CMP0 (PWMA)
82 PWMA_RELOAD0 (PWMA)
83 PWMA_CMP1 (PWMA)
84 PWMA_RELOAD1 (PWMA)
85 PWMA_CMP2 (PWMA)
86 PWMA_RELOAD2 (PWMA)
87 PWMA_CMP3 (PWMA)
88 PWMA_RELOAD3 (PWMA)
89 PWMA_CAP (PWMA)
90 PWMA_RERR (PWMA)
91 PWMA_FAULT (PWMA)
92 CMP3
94 CAN1_ORed_Message_buffer (CAN1)
95 CAN1_Bus_Off (CAN1)
96 CAN1_Error (CAN1)
97 CAN1_Tx_Warning (CAN1)
98 CAN1_Rx_Warning (CAN1)
99 CAN1_Wake_Up (CAN1)

## Licence text in the file
Redistribution and use in source and binary forms, with or without modification, are permitted provided that the following conditions are met: o Redistributions of source code must retain the above copyright notice, this list of conditions and the following disclaimer. o Redistributions in binary form must reproduce the above copyright notice, this list of conditions and the following disclaimer in the documentation and/or other materials provided with the distribution. o Neither the name of Freescale Semiconductor, Inc. nor the names of its contributors may be used to endorse or promote products derived from this software without specific prior written permission. THIS SOFTWARE IS PROVIDED BY THE COPYRIGHT HOLDERS AND CONTRIBUTORS "AS IS" AND. ANY EXPRESS OR IMPLIED WARRANTIES, INCLUDING, BUT NOT LIMITED TO, THE IMPLIED. WARRANTIES OF MERCHANTABILITY AND FITNESS FOR A PARTICULAR PURPOSE ARE. DISCLAIMED. IN NO EVENT SHALL THE COPYRIGHT HOLDER OR CONTRIBUTORS BE LIABLE FOR. ANY DIRECT, INDIRECT, INCIDENTAL, SPECIAL, EXEMPLARY, OR CONSEQUENTIAL DAMAGES (INCLUDING, BUT NOT LIMITED TO, PROCUREMENT OF SUBSTITUTE GOODS OR SERVICES; LOSS OF USE, DATA, OR PROFITS; OR BUSINESS INTERRUPTION) HOWEVER CAUSED AND ON. ANY THEORY OF LIABILITY, WHETHER IN CONTRACT, STRICT LIABILITY, OR TORT (INCLUDING NEGLIGENCE OR OTHERWISE) ARISING IN ANY WAY OUT OF THE USE OF THIS. SOFTWARE, EVEN IF ADVISED OF THE POSSIBILITY OF SUCH DAMAGE.
