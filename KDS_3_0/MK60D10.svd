# MK60D10 register map
Vendor: Freescale Semiconductor, Inc.; Series: Kinetis_K; File version: 1.6
CPU: CM4 r0p1, little endian, no MPU, no FPU, VTOR, 4 interrupt priority bits
Registers are 32-bit, read-write, reset 0x0 unless marked. A register's access mark holds for its fields unless they carry their own. Offsets are from the block's base; [hi:lo] are bit positions; {n}, {i} and the like mark numbered series.

## NVIC — Nested Vectored Interrupt Controller
Base 0xE000E100
{0x0+4i} NVICISER{i} (i=0..3) — Interrupt Set Enable Register n
  [31:0] SETENA — Interrupt set enable bits
{0x80+4i} NVICICER{i} (i=0..3) — Interrupt Clear Enable Register n
  [31:0] CLRENA — Interrupt clear-enable bits
{0x100+4i} NVICISPR{i} (i=0..3) — Interrupt Set Pending Register n
  [31:0] SETPEND — Interrupt set-pending bits
{0x180+4i} NVICICPR{i} (i=0..3) — Interrupt Clear Pending Register n
  [31:0] CLRPEND — Interrupt clear-pending bits
{0x200+4i} NVICIABR{i} (i=0..3) — Interrupt Active bit Register n
  [31:0] ACTIVE — Interrupt active flags
{0x300+i} NVICIP{i} 8-bit (i=0..15) — Interrupt Priority Register {i}
  [7:0] PRI{i} — Priority of the INT_DMA{i} interrupt {i}
0x310 NVICIP16 8-bit — Interrupt Priority Register 16
  [7:0] PRI16 — Priority of the INT_DMA_Error interrupt 16
0x311 NVICIP17 8-bit — Interrupt Priority Register 17
  [7:0] PRI17 — Priority of the INT_MCM interrupt 17
0x312 NVICIP18 8-bit — Interrupt Priority Register 18
  [7:0] PRI18 — Priority of the INT_FTFL interrupt 18
0x313 NVICIP19 8-bit — Interrupt Priority Register 19
  [7:0] PRI19 — Priority of the INT_Read_Collision interrupt 19
0x314 NVICIP20 8-bit — Interrupt Priority Register 20
  [7:0] PRI20 — Priority of the INT_LVD_LVW interrupt 20
0x315 NVICIP21 8-bit — Interrupt Priority Register 21
  [7:0] PRI21 — Priority of the INT_LLWU interrupt 21
0x316 NVICIP22 8-bit — Interrupt Priority Register 22
  [7:0] PRI22 — Priority of the INT_WDOG_EWM interrupt 22
0x317 NVICIP23 8-bit — Interrupt Priority Register 23
  [7:0] PRI23 — Priority of the INT_RNG interrupt 23
0x318 NVICIP24 8-bit — Interrupt Priority Register 24
  [7:0] PRI24 — Priority of the INT_I2C0 interrupt 24
0x319 NVICIP25 8-bit — Interrupt Priority Register 25
  [7:0] PRI25 — Priority of the INT_I2C1 interrupt 25
{0x300+i} NVICIP{i} 8-bit (i=26..28) — Interrupt Priority Register {i}
  [7:0] PRI{i} — Priority of the INT_SPI{i-26} interrupt {i}
0x31D NVICIP29 8-bit — Interrupt Priority Register 29
  [7:0] PRI29 — Priority of the INT_CAN0_ORed_Message_buffer interrupt 29
0x31E NVICIP30 8-bit — Interrupt Priority Register 30
  [7:0] PRI30 — Priority of the INT_CAN0_Bus_Off interrupt 30
0x31F NVICIP31 8-bit — Interrupt Priority Register 31
  [7:0] PRI31 — Priority of the INT_CAN0_Error interrupt 31
0x320 NVICIP32 8-bit — Interrupt Priority Register 32
  [7:0] PRI32 — Priority of the INT_CAN0_Tx_Warning interrupt 32
0x321 NVICIP33 8-bit — Interrupt Priority Register 33
  [7:0] PRI33 — Priority of the INT_CAN0_Rx_Warning interrupt 33
0x322 NVICIP34 8-bit — Interrupt Priority Register 34
  [7:0] PRI34 — Priority of the INT_CAN0_Wake_Up interrupt 34
0x323 NVICIP35 8-bit — Interrupt Priority Register 35
  [7:0] PRI35 — Priority of the INT_I2S0_Tx interrupt 35
0x324 NVICIP36 8-bit — Interrupt Priority Register 36
  [7:0] PRI36 — Priority of the INT_I2S0_Rx interrupt 36
0x325 NVICIP37 8-bit — Interrupt Priority Register 37
  [7:0] PRI37 — Priority of the INT_CAN1_ORed_Message_buffer interrupt 37
0x326 NVICIP38 8-bit — Interrupt Priority Register 38
  [7:0] PRI38 — Priority of the INT_CAN1_Bus_Off interrupt 38
0x327 NVICIP39 8-bit — Interrupt Priority Register 39
  [7:0] PRI39 — Priority of the INT_CAN1_Error interrupt 39
0x328 NVICIP40 8-bit — Interrupt Priority Register 40
  [7:0] PRI40 — Priority of the INT_CAN1_Tx_Warning interrupt 40
0x329 NVICIP41 8-bit — Interrupt Priority Register 41
  [7:0] PRI41 — Priority of the INT_CAN1_Rx_Warning interrupt 41
0x32A NVICIP42 8-bit — Interrupt Priority Register 42
  [7:0] PRI42 — Priority of the INT_CAN1_Wake_Up interrupt 42
0x32B NVICIP43 8-bit — Interrupt Priority Register 43
  [7:0] PRI43 — Priority of interrupt 43
0x32C NVICIP44 8-bit — Interrupt Priority Register 44
  [7:0] PRI44 — Priority of the INT_UART0_LON interrupt 44
0x32D NVICIP45 8-bit — Interrupt Priority Register 45
  [7:0] PRI45 — Priority of the INT_UART0_RX_TX interrupt 45
0x32E NVICIP46 8-bit — Interrupt Priority Register 46
  [7:0] PRI46 — Priority of the INT_UART0_ERR interrupt 46
0x32F NVICIP47 8-bit — Interrupt Priority Register 47
  [7:0] PRI47 — Priority of the INT_UART1_RX_TX interrupt 47
0x330 NVICIP48 8-bit — Interrupt Priority Register 48
  [7:0] PRI48 — Priority of the INT_UART1_ERR interrupt 48
0x331 NVICIP49 8-bit — Interrupt Priority Register 49
  [7:0] PRI49 — Priority of the INT_UART2_RX_TX interrupt 49
0x332 NVICIP50 8-bit — Interrupt Priority Register 50
  [7:0] PRI50 — Priority of the INT_UART2_ERR interrupt 50
0x333 NVICIP51 8-bit — Interrupt Priority Register 51
  [7:0] PRI51 — Priority of the INT_UART3_RX_TX interrupt 51
0x334 NVICIP52 8-bit — Interrupt Priority Register 52
  [7:0] PRI52 — Priority of the INT_UART3_ERR interrupt 52
0x335 NVICIP53 8-bit — Interrupt Priority Register 53
  [7:0] PRI53 — Priority of the INT_UART4_RX_TX interrupt 53
0x336 NVICIP54 8-bit — Interrupt Priority Register 54
  [7:0] PRI54 — Priority of the INT_UART4_ERR interrupt 54
0x337 NVICIP55 8-bit — Interrupt Priority Register 55
  [7:0] PRI55 — Priority of the INT_UART5_RX_TX interrupt 55
0x338 NVICIP56 8-bit — Interrupt Priority Register 56
  [7:0] PRI56 — Priority of the INT_UART5_ERR interrupt 56
0x339 NVICIP57 8-bit — Interrupt Priority Register 57
  [7:0] PRI57 — Priority of the INT_ADC0 interrupt 57
0x33A NVICIP58 8-bit — Interrupt Priority Register 58
  [7:0] PRI58 — Priority of the INT_ADC1 interrupt 58
{0x300+i} NVICIP{i} 8-bit (i=59..61) — Interrupt Priority Register {i}
  [7:0] PRI{i} — Priority of the INT_CMP{i-59} interrupt {i}
{0x300+i} NVICIP{i} 8-bit (i=62..64) — Interrupt Priority Register {i}
  [7:0] PRI{i} — Priority of the INT_FTM{i-62} interrupt {i}
0x341 NVICIP65 8-bit — Interrupt Priority Register 65
  [7:0] PRI65 — Priority of the INT_CMT interrupt 65
0x342 NVICIP66 8-bit — Interrupt Priority Register 66
  [7:0] PRI66 — Priority of the INT_RTC interrupt 66
0x343 NVICIP67 8-bit — Interrupt Priority Register 67
  [7:0] PRI67 — Priority of the INT_RTC_Seconds interrupt 67
{0x300+i} NVICIP{i} 8-bit (i=68..71) — Interrupt Priority Register {i}
  [7:0] PRI{i} — Priority of the INT_PIT{i-68} interrupt {i}
0x348 NVICIP72 8-bit — Interrupt Priority Register 72
  [7:0] PRI72 — Priority of the INT_PDB0 interrupt 72
0x349 NVICIP73 8-bit — Interrupt Priority Register 73
  [7:0] PRI73 — Priority of the INT_USB0 interrupt 73
0x34A NVICIP74 8-bit — Interrupt Priority Register 74
  [7:0] PRI74 — Priority of the INT_USBDCD interrupt 74
0x34B NVICIP75 8-bit — Interrupt Priority Register 75
  [7:0] PRI75 — Priority of the INT_ENET_1588_Timer interrupt 75
0x34C NVICIP76 8-bit — Interrupt Priority Register 76
  [7:0] PRI76 — Priority of the INT_ENET_Transmit interrupt 76
0x34D NVICIP77 8-bit — Interrupt Priority Register 77
  [7:0] PRI77 — Priority of the INT_ENET_Receive interrupt 77
0x34E NVICIP78 8-bit — Interrupt Priority Register 78
  [7:0] PRI78 — Priority of the INT_ENET_Error interrupt 78
0x34F NVICIP79 8-bit — Interrupt Priority Register 79
  [7:0] PRI79 — Priority of interrupt 79
0x350 NVICIP80 8-bit — Interrupt Priority Register 80
  [7:0] PRI80 — Priority of the INT_SDHC interrupt 80
0x351 NVICIP81 8-bit — Interrupt Priority Register 81
  [7:0] PRI81 — Priority of the INT_DAC0 interrupt 81
0x352 NVICIP82 8-bit — Interrupt Priority Register 82
  [7:0] PRI82 — Priority of the INT_DAC1 interrupt 82
0x353 NVICIP83 8-bit — Interrupt Priority Register 83
  [7:0] PRI83 — Priority of the INT_TSI0 interrupt 83
0x354 NVICIP84 8-bit — Interrupt Priority Register 84
  [7:0] PRI84 — Priority of the INT_MCG interrupt 84
0x355 NVICIP85 8-bit — Interrupt Priority Register 85
  [7:0] PRI85 — Priority of the INT_LPTMR0 interrupt 85
0x356 NVICIP86 8-bit — Interrupt Priority Register 86
  [7:0] PRI86 — Priority of interrupt 86
0x357 NVICIP87 8-bit — Interrupt Priority Register 87
  [7:0] PRI87 — Priority of the INT_PORTA interrupt 87
0x358 NVICIP88 8-bit — Interrupt Priority Register 88
  [7:0] PRI88 — Priority of the INT_PORTB interrupt 88
0x359 NVICIP89 8-bit — Interrupt Priority Register 89
  [7:0] PRI89 — Priority of the INT_PORTC interrupt 89
0x35A NVICIP90 8-bit — Interrupt Priority Register 90
  [7:0] PRI90 — Priority of the INT_PORTD interrupt 90
0x35B NVICIP91 8-bit — Interrupt Priority Register 91
  [7:0] PRI91 — Priority of the INT_PORTE interrupt 91
0x35C NVICIP92 8-bit — Interrupt Priority Register 92
  [7:0] PRI92 — Priority of interrupt 92
0x35D NVICIP93 8-bit — Interrupt Priority Register 93
  [7:0] PRI93 — Priority of interrupt 93
0x35E NVICIP94 8-bit — Interrupt Priority Register 94
  [7:0] PRI94 — Priority of the INT_SWI interrupt 94
{0x300+i} NVICIP{i} 8-bit (i=95..239) — Interrupt Priority Register {i}
  [7:0] PRI{i} — Priority of interrupt {i}
0xE00 NVICSTIR — Software Trigger Interrupt Register
  [8:0] INTID — Interrupt ID of the interrupt to trigger, in the range 0-239. For example, a value of 0x03 specifies interrupt IRQ3.

## Notices in the file
Redistribution and use in source and binary forms, with or without modification,
are permitted provided that the following conditions are met:
o Redistributions of source code must retain the above copyright notice, this list
of conditions and the following disclaimer.
o Redistributions in binary form must reproduce the above copyright notice, this
list of conditions and the following disclaimer in the documentation and/or
other materials provided with the distribution.
o Neither the name of Freescale Semiconductor, Inc. nor the names of its
contributors may be used to endorse or promote products derived from this
software without specific prior written permission.
THIS SOFTWARE IS PROVIDED BY THE COPYRIGHT HOLDERS AND CONTRIBUTORS "AS IS" AND
ANY EXPRESS OR IMPLIED WARRANTIES, INCLUDING, BUT NOT LIMITED TO, THE IMPLIED
WARRANTIES OF MERCHANTABILITY AND FITNESS FOR A PARTICULAR PURPOSE ARE
DISCLAIMED. IN NO EVENT SHALL THE COPYRIGHT HOLDER OR CONTRIBUTORS BE LIABLE FOR
ANY DIRECT, INDIRECT, INCIDENTAL, SPECIAL, EXEMPLARY, OR CONSEQUENTIAL DAMAGES
(INCLUDING, BUT NOT LIMITED TO, PROCUREMENT OF SUBSTITUTE GOODS OR SERVICES;
LOSS OF USE, DATA, OR PROFITS; OR BUSINESS INTERRUPTION) HOWEVER CAUSED AND ON
ANY THEORY OF LIABILITY, WHETHER IN CONTRACT, STRICT LIABILITY, OR TORT
(INCLUDING NEGLIGENCE OR OTHERWISE) ARISING IN ANY WAY OUT OF THE USE OF THIS
SOFTWARE, EVEN IF ADVISED OF THE POSSIBILITY OF SUCH DAMAGE.
