# MKV44F15 register map
Vendor: Freescale Semiconductor, Inc.; Series: Kinetis_V; File version: 1.6
CPU: CM4 r0p1, little endian, no MPU, FPU, VTOR, 4 interrupt priority bits
Registers are 8-bit, read-write, reset 0x0 unless marked. A register's access mark holds for its fields unless they carry their own. Offsets are from the block's base; [hi:lo] are bit positions; {n}, {i} and the like mark numbered series.

## NVIC — Nested Vectored Interrupt Controller
Base 0xE000E100
{0x0+4i} NVICISER{i} 32-bit (i=0..3) — Interrupt Set Enable Register n
  [31:0] SETENA — Interrupt set enable bits
{0x80+4i} NVICICER{i} 32-bit (i=0..3) — Interrupt Clear Enable Register n
  [31:0] CLRENA — Interrupt clear-enable bits
{0x100+4i} NVICISPR{i} 32-bit (i=0..3) — Interrupt Set Pending Register n
  [31:0] SETPEND — Interrupt set-pending bits
{0x180+4i} NVICICPR{i} 32-bit (i=0..3) — Interrupt Clear Pending Register n
  [31:0] CLRPEND — Interrupt clear-pending bits
{0x200+4i} NVICIABR{i} 32-bit (i=0..3) — Interrupt Active bit Register n
  [31:0] ACTIVE — Interrupt active flags
{0x300+i} NVICIP{i} (i=0..15) — Interrupt Priority Register {i}
  [7:4] PRI{i} — Priority of the INT_DMA{i} interrupt {i}
0x310 NVICIP16 — Interrupt Priority Register 16
  [7:4] PRI16 — Priority of the INT_DMA_Error interrupt 16
0x311 NVICIP17 — Interrupt Priority Register 17
  [7:4] PRI17 — Priority of the INT_MCM interrupt 17
0x312 NVICIP18 — Interrupt Priority Register 18
  [7:4] PRI18 — Priority of the INT_FTFA interrupt 18
0x313 NVICIP19 — Interrupt Priority Register 19
  [7:4] PRI19 — Priority of the INT_FTFA_Collision interrupt 19
0x314 NVICIP20 — Interrupt Priority Register 20
  [7:4] PRI20 — Priority of the INT_PMC interrupt 20
0x315 NVICIP21 — Interrupt Priority Register 21
  [7:4] PRI21 — Priority of the INT_LLWU interrupt 21
0x316 NVICIP22 — Interrupt Priority Register 22
  [7:4] PRI22 — Priority of the INT_WDOG_EWM interrupt 22
0x317 NVICIP23 — Interrupt Priority Register 23
  [7:4] PRI23 — Priority of interrupt 23
0x318 NVICIP24 — Interrupt Priority Register 24
  [7:4] PRI24 — Priority of the INT_I2C0 interrupt 24
0x319 NVICIP25 — Interrupt Priority Register 25
  [7:4] PRI25 — Priority of interrupt 25
0x31A NVICIP26 — Interrupt Priority Register 26
  [7:4] PRI26 — Priority of the INT_SPI interrupt 26
{0x300+i} NVICIP{i} (i=27..30) — Interrupt Priority Register {i}
  [7:4] PRI{i} — Priority of interrupt {i}
0x31F NVICIP31 — Interrupt Priority Register 31
  [7:4] PRI31 — Priority of the INT_UART0_RX_TX interrupt 31
0x320 NVICIP32 — Interrupt Priority Register 32
  [7:4] PRI32 — Priority of the INT_UART0_ERR interrupt 32
0x321 NVICIP33 — Interrupt Priority Register 33
  [7:4] PRI33 — Priority of the INT_UART1_RX_TX interrupt 33
0x322 NVICIP34 — Interrupt Priority Register 34
  [7:4] PRI34 — Priority of the INT_UART1_ERR interrupt 34
{0x300+i} NVICIP{i} (i=35..37) — Interrupt Priority Register {i}
  [7:4] PRI{i} — Priority of interrupt {i}
0x326 NVICIP38 — Interrupt Priority Register 38
  [7:4] PRI38 — Priority of the INT_ADC_ERR interrupt 38
0x327 NVICIP39 — Interrupt Priority Register 39
  [7:4] PRI39 — Priority of the INT_ADCA interrupt 39
0x328 NVICIP40 — Interrupt Priority Register 40
  [7:4] PRI40 — Priority of the INT_CMP0 interrupt 40
0x329 NVICIP41 — Interrupt Priority Register 41
  [7:4] PRI41 — Priority of the INT_CMP1 interrupt 41
{0x300+i} NVICIP{i} (i=42..47) — Interrupt Priority Register {i}
  [7:4] PRI{i} — Priority of interrupt {i}
{0x300+i} NVICIP{i} (i=48..51) — Interrupt Priority Register {i}
  [7:4] PRI{i} — Priority of the INT_PIT{i-48} interrupt {i}
0x334 NVICIP52 — Interrupt Priority Register 52
  [7:4] PRI52 — Priority of the INT_PDB0 interrupt 52
0x335 NVICIP53 — Interrupt Priority Register 53
  [7:4] PRI53 — Priority of interrupt 53
0x336 NVICIP54 — Interrupt Priority Register 54
  [7:4] PRI54 — Priority of the INT_XBARA interrupt 54
0x337 NVICIP55 — Interrupt Priority Register 55
  [7:4] PRI55 — Priority of the INT_PDB1 interrupt 55
0x338 NVICIP56 — Interrupt Priority Register 56
  [7:4] PRI56 — Priority of the INT_DAC interrupt 56
0x339 NVICIP57 — Interrupt Priority Register 57
  [7:4] PRI57 — Priority of the INT_MCG interrupt 57
0x33A NVICIP58 — Interrupt Priority Register 58
  [7:4] PRI58 — Priority of the INT_LPTMR0 interrupt 58
0x33B NVICIP59 — Interrupt Priority Register 59
  [7:4] PRI59 — Priority of the INT_PORTA interrupt 59
0x33C NVICIP60 — Interrupt Priority Register 60
  [7:4] PRI60 — Priority of the INT_PORTB interrupt 60
0x33D NVICIP61 — Interrupt Priority Register 61
  [7:4] PRI61 — Priority of the INT_PORTC interrupt 61
0x33E NVICIP62 — Interrupt Priority Register 62
  [7:4] PRI62 — Priority of the INT_PORTD interrupt 62
0x33F NVICIP63 — Interrupt Priority Register 63
  [7:4] PRI63 — Priority of the INT_PORTE interrupt 63
0x340 NVICIP64 — Interrupt Priority Register 64
  [7:4] PRI64 — Priority of the INT_SWI interrupt 64
0x341 NVICIP65 — Interrupt Priority Register 65
  [7:4] PRI65 — Priority of interrupt 65
0x342 NVICIP66 — Interrupt Priority Register 66
  [7:4] PRI66 — Priority of the INT_ENC_COMPARE interrupt 66
0x343 NVICIP67 — Interrupt Priority Register 67
  [7:4] PRI67 — Priority of the INT_ENC_HOME interrupt 67
0x344 NVICIP68 — Interrupt Priority Register 68
  [7:4] PRI68 — Priority of the INT_ENC_WDOG_SAB interrupt 68
0x345 NVICIP69 — Interrupt Priority Register 69
  [7:4] PRI69 — Priority of the INT_ENC_INDEX interrupt 69
0x346 NVICIP70 — Interrupt Priority Register 70
  [7:4] PRI70 — Priority of the INT_CMP2 interrupt 70
0x347 NVICIP71 — Interrupt Priority Register 71
  [7:4] PRI71 — Priority of interrupt 71
0x348 NVICIP72 — Interrupt Priority Register 72
  [7:4] PRI72 — Priority of interrupt 72
0x349 NVICIP73 — Interrupt Priority Register 73
  [7:4] PRI73 — Priority of the INT_ADCB interrupt 73
0x34A NVICIP74 — Interrupt Priority Register 74
  [7:4] PRI74 — Priority of interrupt 74
0x34B NVICIP75 — Interrupt Priority Register 75
  [7:4] PRI75 — Priority of the INT_CAN0_ORed_Message_buffer interrupt 75
0x34C NVICIP76 — Interrupt Priority Register 76
  [7:4] PRI76 — Priority of the INT_CAN0_Bus_Off interrupt 76
0x34D NVICIP77 — Interrupt Priority Register 77
  [7:4] PRI77 — Priority of the INT_CAN0_Error interrupt 77
0x34E NVICIP78 — Interrupt Priority Register 78
  [7:4] PRI78 — Priority of the INT_CAN0_Tx_Warning interrupt 78
0x34F NVICIP79 — Interrupt Priority Register 79
  [7:4] PRI79 — Priority of the INT_CAN0_Rx_Warning interrupt 79
0x350 NVICIP80 — Interrupt Priority Register 80
  [7:4] PRI80 — Priority of the INT_CAN0_Wake_Up interrupt 80
0x351 NVICIP81 — Interrupt Priority Register 81
  [7:4] PRI81 — Priority of the INT_PWMA_CMP0 interrupt 81
0x352 NVICIP82 — Interrupt Priority Register 82
  [7:4] PRI82 — Priority of the INT_PWMA_RELOAD0 interrupt 82
0x353 NVICIP83 — Interrupt Priority Register 83
  [7:4] PRI83 — Priority of the INT_PWMA_CMP1 interrupt 83
0x354 NVICIP84 — Interrupt Priority Register 84
  [7:4] PRI84 — Priority of the INT_PWMA_RELOAD1 interrupt 84
0x355 NVICIP85 — Interrupt Priority Register 85
  [7:4] PRI85 — Priority of the INT_PWMA_CMP2 interrupt 85
0x356 NVICIP86 — Interrupt Priority Register 86
  [7:4] PRI86 — Priority of the INT_PWMA_RELOAD2 interrupt 86
0x357 NVICIP87 — Interrupt Priority Register 87
  [7:4] PRI87 — Priority of the INT_PWMA_CMP3 interrupt 87
0x358 NVICIP88 — Interrupt Priority Register 88
  [7:4] PRI88 — Priority of the INT_PWMA_RELOAD3 interrupt 88
0x359 NVICIP89 — Interrupt Priority Register 89
  [7:4] PRI89 — Priority of the INT_PWMA_CAP interrupt 89
0x35A NVICIP90 — Interrupt Priority Register 90
  [7:4] PRI90 — Priority of the INT_PWMA_RERR interrupt 90
0x35B NVICIP91 — Interrupt Priority Register 91
  [7:4] PRI91 — Priority of the INT_PWMA_FAULT interrupt 91
0x35C NVICIP92 — Interrupt Priority Register 92
  [7:4] PRI92 — Priority of the INT_CMP3 interrupt 92
{0x300+i} NVICIP{i} (i=93..239) — Interrupt Priority Register {i}
  [7:4] PRI{i} — Priority of interrupt {i}
0xE00 NVICSTIR 32-bit — Software Trigger Interrupt Register
  [8:0] INTID — Interrupt ID of the interrupt to trigger, in the range 0-239. For example, a value of 0x03 specifies interrupt IRQ3.
